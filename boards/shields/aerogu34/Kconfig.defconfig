## boards/shields/aerogu34/Kconfig.defconfig
```kconfig
if SHIELD_AEROGU34_LEFT || SHIELD_AEROGU34_RIGHT

config ZMK_SPLIT
    default y

config NFCT_PINS_AS_GPIOS
    default y

config BT_BAS
    default y

config ZMK_BATTERY_REPORTING
    default y

endif

if SHIELD_AEROGU34_RIGHT

config ZMK_KEYBOARD_NAME
    default "Aerogu34"

config ZMK_SPLIT_ROLE_CENTRAL
    default y

config ZMK_SPLIT_BLE_CENTRAL_BATTERY_LEVEL_FETCHING
    default y

config ZMK_SPLIT_BLE_CENTRAL_BATTERY_LEVEL_PROXY
    default y

endif
```

## config/west.yml
```yaml
self:
manifest:
  defaults:
    revision: main
  remotes:
    - name: cormoran
      url-base: https://github.com/cormoran
    - name: sekigon-gonnoc
      url-base: https://github.com/sekigon-gonnoc
    - name: caksoylar
      url-base: https://github.com/caksoylar
    - name: prospector
      url-base: https://github.com/t-ogura
    - name: kot149
      url-base: https://github.com/kot149
    - name: yusukekitazo
      url-base: https://github.com/yusukekitazo
  projects:
    # ZMK: cormoran fork, main+dya = Custom Studio Protocol base per the
    # official developer guide (レベル2)
    - name: zmk
      remote: cormoran
      revision: e5c9b6915b56801193e359dd9bad4a167ce0d1b8 # main+dya (2026-08-24)
      import: app/west.yml
    # Zephyr fork required alongside main+dya per developer guide レベル2
    - name: zephyr
      remote: cormoran
      revision: 7c6b4cc486ecb41a68d9c2b1def2bb3178fbb826 # v4.1.0+zmk-fixes+nrf-half-duplex-uart (2026-08-24)
      clone-depth: 1
      west-commands: scripts/west-commands.yml
      import:
        name-blocklist:
          - ci-tools
          - hal_altera
          - hal_cypress
          - hal_infineon
          - hal_microchip
          - hal_nxp
          - hal_openisa
          - hal_xtensa
          - hal_st
          - hal_ti
          - loramac-node
          - mcuboot
          - mcumgr
          - net-tools
          - openthread
          - edtt
          - trusted-firmware-m
    # Trackball driver
    - name: zmk-driver-paw3222
      revision: df652881be2520bde4f64ab6ca35e4c5708f4f9b # main (2026-08-24)
      remote: sekigon-gonnoc
    # RGB LED widget (main supports Zephyr 4.1 / xiao_ble naming)
    - name: zmk-rgbled-widget
      revision: e6b467792a1dabef8cfa5c9fd26bfefc9c16662b # main (2026-08-24)
      remote: caksoylar
    # DYA Studio modules (main = v4-compatible)
    - name: zmk-module-ble-management
      revision: 57738cc4fc6ba80e82a7ac57741a0339cb186cd4 # main (2026-08-24)
      remote: cormoran
    - name: zmk-module-battery-history
      revision: 307755dd2ad4d320e14de162e8e5ef018f29d929 # main (2026-08-24)
      remote: cormoran
    - name: zmk-module-settings-rpc
      revision: 78f86df9e6c5edaf57bef3ccbd7f360cfdf49291 # main (2026-08-24)
      remote: cormoran
    - name: zmk-module-runtime-input-processor
      revision: 43618985f8c9d5457cc333b7ca0733f2d361911e # main (2026-08-24)
      remote: cormoran
    # Deadzone input processor
    - name: zmk-input-processor-deadzone
      revision: 7ae1bcb0d367ad00b7fa8836cf9a9b197d88e555 # main (2026-08-24)
      remote: prospector
    # Prospector
    - name: prospector-zmk-module
      remote: prospector
      revision: c124152f12d8c3372b1120eba05267bc7d63d06f # main (2026-08-24)
      path: modules/prospector-zmk-module
    # Mouse gesture recognition (J+K+L combo)
    - name: zmk-mouse-gesture
      remote: kot149
      revision: 62f3c9d8ca6763e160b73efc46108c61dd0243a0 # v1 (2026-08-24)
    # iOS-style scroll inertia (own fork of mjmjm0101/zmk-input-processor-scroll-inertia)
    - name: zmk-input-processor-scroll-inertia
      remote: yusukekitazo
      revision: f7dadefee453d555fe066d13a3de3bb60739b45e # main (2026-08-24)
    # レベル2 core modules (developer guide step 4)
    - name: zmk-feature-custom-settings
      remote: cormoran
      revision: c6a7fef3a3be3d3ace5de9a4b0628c6418cd1f3f # main (2026-08-24)
    - name: zmk-feature-fast-keymap
      remote: cormoran
      revision: 8dac76de0ba38588ba39ca498910e24f8332bc6b # main (2026-08-24)
    # Keymap / Macro / Combo tab modules (developer guide) -- confirmed working
    - name: zmk-feature-runtime-macro
      remote: cormoran
      revision: 38530962eb7061b60efcb98e84585cfb1f0cb6de # main (2026-08-24)
    - name: zmk-feature-runtime-combo
      remote: cormoran
      revision: d9490e7b5d41c516221d131241009e81740efcee # main (2026-08-24)
    # Connection / OS tab modules (developer guide)
    - name: zmk-feature-default-layer
      remote: cormoran
      revision: b25cb5b324da2d9bbc84e1877c775f5b2b7c6845 # codex/custom-rpc-rewrite (2026-08-24)
    - name: zmk-feature-os-detection
      remote: cormoran
      revision: 3052679f645b8fc1997275c2eaa6b86bdd55ca01 # main (2026-08-24)
    # 診断と開発補助タブ (developer guide)
    - name: zmk-feature-device-info
      remote: cormoran
      revision: 8cedd2dd9f04e19ea5a17b94914dd47a09d8db11 # main (2026-08-24)
    - name: zmk-feature-watchdog
      remote: cormoran
      revision: 84ad14c6c3645dc40b23f45d08ab45418655f912 # main (2026-08-24)
    - name: zmk-module-devtool
      remote: cormoran
      revision: 9938a2c73c06d6e65ba2c0b68c9aa044a467eafc # main (2026-08-24)
    - name: zmk-feature-kscan-diagnostics
      remote: cormoran
      revision: 1432f7fe0cfe903cd7d3c9931ae6bd6f2e1f328e # main (2026-08-24)
    - name: zmk-feature-zephyr-setting-expose
      remote: cormoran
      revision: 5c89bc71122840ea46032fc241bef8665b99728a # main (2026-08-24)
    - name: zmk-feature-input-stream
      remote: cormoran
      revision: aeb015908a42a7615ccdccc7feb3a10d23132a71 # main (2026-08-24)
  self:
    path: config
```
